## config/boards/shields/mdactyl/Kconfig.defconfig
```kconfig
if SHIELD_MDACTYL_LEFT

config ZMK_KEYBOARD_NAME
    default "mDactyl Left"
endif

if SHIELD_MDACTYL_RIGHT

config ZMK_KEYBOARD_NAME
    default "mDactyl Right"
    
config ZMK_SPLIT_BLE_ROLE_CENTRAL
    default y

endif

if SHIELD_MDACTYL_LEFT || SHIELD_MDACTYL_RIGHT

config ZMK_SPLIT
    default y

endif
```

## config/boards/shields/mdactyl/Kconfig.shield
```kconfig
# Copyright (c) 2020 Ryan Cross
# # SPDX-License-Identifier: MIT
#
config SHIELD_MDACTYL_LEFT
  def_bool $(shields_list_contains,mdactyl_left)

config SHIELD_MDACTYL_RIGHT
  def_bool $(shields_list_contains,mdactyl_right)
```

## config/west.yml
```yaml
manifest:
  remotes:
    - name: zmkfirmware
      url-base: https://github.com/CrossR
  projects:
    - name: zmk
      remote: zmkfirmware 
      revision: CrossR/RowOffset 
      import: app/west.yml
  self:
    path: config
```
